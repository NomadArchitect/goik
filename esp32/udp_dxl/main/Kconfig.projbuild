## esp32/udp_dxl/main/Kconfig.projbuild
```kconfig
menu "Example Configuration"

    config IPV4
        bool "IPV4"
        default y

    config IPV6
        bool "IPV6"
        default n
        select EXAMPLE_CONNECT_IPV6

    config PORT
        int "Port"
        range 0 65535
        default 3333
        help
            Local port the example server will listen on.

endmenu
```
